///////////////////////////////////////////////////////////////////////////////
/// @file       screen.c
/// @copyright  Copyright (c) Philtronix ltd - All rights Reserved
///             Unauthorised copying of this file, via any medium is strictly
///             prohibited.
///
/// @brief      Debug screen
///////////////////////////////////////////////////////////////////////////////

///////////////////////////////////////////////////////////////////////////////
// Includes
///////////////////////////////////////////////////////////////////////////////
#include <stdarg.h>
#include <stdbool.h>
#include <stdio.h>

#include "stm32f4xx_hal.h"

#include "stdint.h"
#include "CLI.h"
#include "screen.h"
#include "usb_hid_keyboard.h"

///////////////////////////////////////////////////////////////////////////////
// Defines
///////////////////////////////////////////////////////////////////////////////

#define CLS             "\033[2J"       // Esc[2J Clear entire screen

///////////////////////////////////////////////////////////////////////////////
// Type definitions
///////////////////////////////////////////////////////////////////////////////

///////////////////////////////////////////////////////////////////////////////
// Private Function declarations
///////////////////////////////////////////////////////////////////////////////

///////////////////////////////////////////////////////////////////////////////
// Variable Definitions
///////////////////////////////////////////////////////////////////////////////

// 80x24
char screen[24][84] =
{
	//12345678901234567890123456789012345678901234567890123456789012345678901234567890
	//         1         2         3         4         5         6         7         8
	{"********************************************************************************\r\n"},	// 1
	{"|                                                                              |\r\n"},	// 2
	{"|  Key 1 :                                                                     |\r\n"},	// 3
	{"|  Key 2 :                                                                     |\r\n"},	// 4
	{"|  Key 3 :                                                                     |\r\n"},	// 5
	{"|  Key 4 :                                                                     |\r\n"},	// 6
	{"|  Key T :                                                                     |\r\n"},	// 7
	{"|  Ticks :                                                                     |\r\n"},	// 8
	{"|                                                                              |\r\n"},	// 9
	{"|                                                                              |\r\n"},	// 10
	{"|                                                                              |\r\n"},	// 11
	{"|                                                                              |\r\n"},	// 12
	{"|                                                                              |\r\n"},	// 13
	{"|                                                                              |\r\n"},	// 14
	{"|                                                                              |\r\n"},	// 15
	{"|                                                                              |\r\n"},	// 16
	{"|                                                                              |\r\n"},	// 17
	{"|                                                                              |\r\n"},	// 18
	{"|                                                                              |\r\n"},	// 19
	{"|                                                                              |\r\n"},	// 20
	{"|                                                                              |\r\n"},	// 21
	{"| >                                                                            |\r\n"},	// 22
	{"|                                                                              |\r\n"},	// 23
	{"********************************************************************************"},	    // 24
	//12345678901234567890123456789012345678901234567890123456789012345678901234567890
	//         1         2         3         4         5         6         7         8
};


///////////////////////////////////////////////////////////////////////////////
// Public Function definitions
///////////////////////////////////////////////////////////////////////////////
void ScreenInit(void)
{
	RefreshScreen();
}

// Called by Main()
void ScreenUpdate(void)
{
	for (int i = 0; i < NUM_KEYS; i++)
	{
		if (true == USB_IsKeyPressed(i))
		{
			OutputAt(3 + i, 12, "Down  : %d", USB_GetKeycount(i));
		}
		else
		{
			OutputAt(3 + i, 12, "Up    : %d", USB_GetKeycount(i));
		}
	}

	char szBuffer[50] = {0};
	if (TOGGLE_DIR_CLOCK == USB_GetToggDirection())
	{
		sprintf(szBuffer, "Clock : %d ", USB_GetTogglecount());
	}
	else
	{
		sprintf(szBuffer, "Anti  : %d ", USB_GetTogglecount());
	}
	OutputAt(8, 12, szBuffer);
}

void ClearScreen(void)
{
	Output(CLS);
}

void RefreshScreen(void)
{
	ClearScreen();

	// TODO : Remove ?
//	HAL_Delay(500);

	// Move cursor to start od screen
	OutputAt(1, 1, "");

	for (int i = 0; i < 24; i++)
	{
		Output(screen[i]);
	}

	Prompt();
}

///////////////////////////////////////////////////////////////////////////////
// Private Function definitions
///////////////////////////////////////////////////////////////////////////////

